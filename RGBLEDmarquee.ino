//------------------------------------------------------------------------------
// RGB LED scrolling text marquee controlled by Arduino
// dan@marginallycelver.com 2014-12-10
//------------------------------------------------------------------------------
// Copyright at end of file.
// please see http://www.github.com/MarginallyClever/RGBLEDMarquee for more information.

//--------------------------------------------------------------------------------
// CONSTANTS
//--------------------------------------------------------------------------------

// IMPORTANT: To reduce NeoPixel burnout risk, add 1000 uF capacitor across
// pixel power leads, add 300 - 500 Ohm resistor on first pixel's data input
// and minimize distance between Arduino and first pixel.  Avoid connecting
// on a live circuit...if you must, connect GND first.

#include <Adafruit_NeoPixel.h>

#define VERBOSE         (0) // higher numbers for more output

#define PIN             (6)  // Arduino pin connected to LED data wire
#define STRAND_LENGTH   (64)  // How many LEDS in this strand?  An UNO can handle up to 256.

#define MAX_MESSAGE_LEN (140)  // One tweet
#define BAUD            (57600)  // Speed of serial
#define GRID_W          (8)  // Maruqee size
#define GRID_H          (8)  // Maruqee size

#define FPS             (60)  // animation smoothness
#define SCROLL_STEP     (0.3f)  // animation speed
#define BACKWARDS       (1)  // set to 0 if you wired your grid backwards
#define ANTIALIAS       (1)  // set to 0 if you don't want blending

#define SWIZZLE(x)      (x)  // white text on black background
//#define SWIZZLE(x)      (1.0-x)  // black text on white background


#define FPS_DELAY       (1000/FPS)


// 1 means on
// 0 means off
// saved a 128x128 pixel font (http://agtp.romhack.net/fonts/hithin_8x8.bmp)
// as a RAW image using photoshop.
// opened it in notepad and replaced all [^ÿ] with 0, all ÿ with 1,
// pasted it in here as font[].
#define LETTER_W        (8)
#define LETTER_H        (8)
#define FONT_W_PIXELS   (128)
#define FONT_H_PIXELS   (128)
#define FONT_W_CHARS    (FONT_W_PIXELS/LETTER_W)
#define FONT_H_CHARS    (FONT_H_PIXELS/LETTER_H)

// An array is a numerically indexed list.  The first index number is always 0.
// this array is called font and contains the data to draw 256 characters of ASCII text.
// PROGMEM tells Arduino "don't load this array into RAM" ...because it doesn't have that much RAM and would crash.
// instead it loads the array as needed.  search for "font" to find out how.
// There are more complicated ways to store this map that use a lot less memory... but who cares?
const prog_uchar PROGMEM font[FONT_W_PIXELS*FONT_H_PIXELS] = {
0,0,0,0,0,0,0,0,0,1,1,1,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0,
0,0,0,0,0,0,0,0,1,0,0,0,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1,
0,0,0,0,0,0,0,0,1,0,1,0,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0,
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0,0,0,0,0,0,0,0,0,0,0,0,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0,
};


//--------------------------------------------------------------------------------
// GLOBALS
//--------------------------------------------------------------------------------


// Parameter 1 = number of pixels in strip
// Parameter 2 = Arduino pin number (most are valid)
// Parameter 3 = pixel type flags, add together as needed:
//   NEO_KHZ800  800 KHz bitstream (most NeoPixel products w/WS2812 LEDs)
//   NEO_KHZ400  400 KHz (classic 'v1' (not v2) FLORA pixels, WS2811 drivers)
//   NEO_GRB     Pixels are wired for GRB bitstream (most NeoPixel products)
//   NEO_RGB     Pixels are wired for RGB bitstream (v1 FLORA pixels, not v2)
Adafruit_NeoPixel strip = Adafruit_NeoPixel(STRAND_LENGTH, PIN, NEO_RGB + NEO_KHZ800);

// the message being displayed
char current_message[MAX_MESSAGE_LEN+1]="";
int current_message_length=21;
int message_width_in_pixels=0;

// the next message waiting to appear
char new_message[MAX_MESSAGE_LEN+1] = "Hello, World.";
int new_message_received=0;


//--------------------------------------------------------------------------------
// METHODS
//--------------------------------------------------------------------------------


void setup() {
  Serial.begin(BAUD);
  Serial.println(F("Hello, World."));  // F() stores the string in program memory.
  
  strip.begin();
  strip.show(); // Initialize all pixels to 'off'

  new_message_received = strlen(new_message);
  prepare_new_message();
}


void loop() {
  read_message();
  display_message();
}


// Listen for instructions from serial.
void read_message() {
  char c;
  
  while(Serial.available()) {
    c = Serial.read();
    if(new_message_received < MAX_MESSAGE_LEN) {
      new_message[new_message_received++] = c;
    }
    if(c=='\n') {
      new_message_received--;
      new_message[new_message_received] = 0;  // end string
      prepare_new_message();
      break;
    }
  }
}


// Copy the new message to the current message
void prepare_new_message() {
  Serial.print(F("Preparing '"));
  Serial.print(new_message);
  Serial.println(F("'"));
  
  current_message_length = new_message_received;
  strcpy(current_message,new_message);

  new_message_received=0;
  message_width_in_pixels = LETTER_W * current_message_length;
}


// Turn (x,y) into the correct pixel address.
// This only works because the lights are wired in an S pattern.
void p(int x,int y,long color) {
  int a = y*GRID_W;
  if( ( y % 2 ) == BACKWARDS ) {  // % is modulus.
    // y%2 is false when y is an even number - rows 0,2,4,6.
    a += x;
  } else {
    // y%2 is true when y is an odd number - rows 1,3,5,7.
    a += GRID_W - 1 - x;
  }
  a%=STRAND_LENGTH;
  strip.setPixelColor(a,color);
}


// some wavy rainbow color fun
  return strip.Color(v*(cos(        x*0.3)*127.0f+127),
                     v*(sin(        x*0.1)*127.0f+127),
                     v*(sin(3.14159+x*0.1)*127.0f+127));
}


float get_pixel(int x,int y) {
  int nx,nx2,fx,fy,letter_being_drawn;
  
  nx = x;
  nx2 = 0;
  if( nx < 0 ) {
    letter_being_drawn = 0;
  } else {
    nx = x / LETTER_W;
    if( nx > current_message_length ) {
      letter_being_drawn = 0;
    } else {
      nx2 = x % LETTER_W;
      letter_being_drawn = current_message[nx];
    }
  }
  
  fy = ( letter_being_drawn / FONT_W_CHARS ) * LETTER_H + y;
  fx = ( letter_being_drawn % FONT_W_CHARS ) * LETTER_W + nx2;
  if( fy > FONT_H_PIXELS-1 ) fy = FONT_H_PIXELS-1;
  if( fx > FONT_W_PIXELS-1 ) fx = FONT_W_PIXELS-1;
  
  // if pixel == WHITE_ON_BLACK, turn on the light
  // pgm_read_byte_near() pulls the 1 or 0 from font into RAM
  return pgm_read_byte_near(font + fy * FONT_W_PIXELS + fx);
}


void display_message() {
  // for animations
  float pixel, antialias;
  float scroll_step=-GRID_W;  // we start with the message off the right side of the grid
  int x,y;
  long clock=millis();

  do {
    if(scroll_step<0) {
      pixel = scroll_step;
      while(pixel<0) pixel++;
      antialias = pixel - (int)pixel;
    } else {
      antialias = scroll_step - (int)scroll_step;
    }

    // for every dot on the LED grid
    for(y=0;y<GRID_H;++y) {
      for(x=0;x<GRID_W;++x) {
        // find the 1 or 0 in the message to display at this dot
#if ANTIALIAS == 0        
        pixel = get_pixel(x+scroll_step,y);
#else
	    pixel = get_pixel(x+scroll_step  ,y) * (1.0f - antialias)
              + get_pixel(x+scroll_step+1,y) * (antialias);
#endif

		// draw the pixel
        p(x,
          y,
          c(x+scroll_step,y, SWIZZLE(pixel) )
        );
#if VERBOSE > 2
        Serial.print((char)letter_being_drawn);
        Serial.print(',');
        Serial.print(fy);
        Serial.print(',');
        Serial.print(fx);
        Serial.print(',');
        Serial.print( pixel,DEC);
        Serial.print('\t');
#endif
      }
#if VERBOSE > 2
      Serial.print("\n");
#endif
    }  
    strip.show();
#if VERBOSE > 1
    Serial.print(n);
    Serial.print('-');
    Serial.println(scroll_step);
#endif

    // animation time - adjust scroll_step, which will push the message to the left. 
    while( millis() - clock < FPS);
    clock=millis();
    scroll_step+= SCROLL_STEP;
	// stop after the message has gone off the grid.
  } while(scroll_step < message_width_in_pixels + GRID_W);
}


/**
* This file is part of RGBLEDMarquee.
*
* RGBLEDMarquee is free software: you can redistribute it and/or modify
* it under the terms of the GNU General Public License as published by
* the Free Software Foundation, either version 3 of the License, or
* (at your option) any later version.
*
* RGBLEDMarquee is distributed in the hope that it will be useful,
* but WITHOUT ANY WARRANTY; without even the implied warranty of
* MERCHANTABILITY or FITNESS FOR A PARTICULAR PURPOSE. See the
* GNU General Public License for more details.
*
* You should have received a copy of the GNU General Public License
* along with Arduino Timer Interrupt. If not, see <http://www.gnu.org/licenses/>.
*/
